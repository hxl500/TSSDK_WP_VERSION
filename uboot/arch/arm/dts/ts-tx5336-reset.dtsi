// SPDX-License-Identifier: GPL-2.0+
/*
 * dts file for tsingmicro dt53
 *
 * Copyright 2022 Beijing Tsingmicro Intelligent Technology Co.,Ltd.
 *
 */

#include <dt-bindings/reset/ts-tx5336-resets.h>
/ {
	ts_reset: reset-controller {
		compatible = "ts,tx5336-reset";
		reg = <0x0 0xF038A000 0x0 0x1000>;
		#reset-cells = <1>;
	};
};

&gmac0 {
	resets = <&ts_reset TS_GMAC_AXI_RST>, <&ts_reset TS_GMAC_AHB_RST>;
};

&qspi {
	resets = <&ts_reset TS_QSPI_APB_RST>, <&ts_reset TS_QSPI_AHB_RST>,
			 <&ts_reset TS_QSPI_REF_RST>;
	reset-name = "ospi_apb", "ospi_ahb", "ospi_intf";
};

#if 0
&nand0 {
	resets = <&ts_reset TS_RST_NFC_AHB>, <&ts_reset TS_RST_NFC_FUNC_BLOCK>,
			 <&ts_reset TS_RST_NFC_GLOBAL>;
	reset-name = "nfc_ahb", "nfc_func_block", "nfc_global";
};

&ssi0 {
	resets = <&ts_reset TS_RST_SPI0_APB>, <&ts_reset TS_RST_SPI0_SERIAL_INTF>,
			 <&ts_reset TS_RST_SPI0_GLOBAL>;
};


// &sdhci0 {
	// resets = <&ts_reset TS_RST_MSHC0_SLAVE>, <&ts_reset TS_RST_MSHC0_MASTER>,
		//  <&ts_reset TS_RST_MSHC0_BASE_CLK>, <&ts_reset TS_RST_MSHC0_GLOBAL>,
		//  <&ts_reset TS_RST_MSHC0_LOWFREQ_CLK>, <&ts_reset TS_RST_MSHC0_TIMER>;
// };
&sdhci1 {
	resets = <&ts_reset TS_RST_MSHC1_SLAVE>, <&ts_reset TS_RST_MSHC1_MASTER>,
		 <&ts_reset TS_RST_MSHC1_BASE_CLK>, <&ts_reset TS_RST_MSHC1_GLOBAL>,
		 <&ts_reset TS_RST_MSHC1_LOWFREQ_CLK>, <&ts_reset TS_RST_MSHC1_TIMER>;
};
#endif
