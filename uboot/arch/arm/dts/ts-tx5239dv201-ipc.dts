// SPDX-License-Identifier: GPL-2.0+
/*
 * dts file for tsingmicro tx51xx
 *
 * Copyright 2022 Beijing Tsingmicro Intelligent Technology Co.,Ltd.
 *
 */

/dts-v1/;

#include "ts_tx5112.dtsi"
#include "ts_tx51xx_ipc.dtsi"

/ {
	model = "Tsingmicro TX5239DV201";
	compatible = "ts,tx5239dv201-ipc";

	aliases {
		gpio0 = &gpio0;
		sd0 = &sdhci1;
		serial0 = &uart0;
		spi0 = &qspi;
		spi1 = &ssi0;
	};

	memory@0 {
		device_type = "memory";
		reg = <0x0 0x08000000>;
	};
};
