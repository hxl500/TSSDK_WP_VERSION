// SPDX-License-Identifier: GPL-2.0+
/*
 * dts file for tsingmicro tx5239
 *
 * Copyright 2022 Beijing Tsingmicro Intelligent Technology Co.,Ltd.
 *
 */

/dts-v1/;

#include "ts_tx5239.dtsi"
#include "ts_tx52xx_evb132.dtsi"

/ {
	model = "Tsingmicro TX5239DV300";
	compatible = "ts,tx5239dv300-evb132";

	aliases {
		gpio0 = &gpio0;
		mmc0 = &sdhci0;
		sd0 = &sdhci1;
		serial0 = &uart0;
		spi0 = &qspi;
		spi1 = &ssi0;
	};

	memory@0 {
		device_type = "memory";
		reg = <0x0 0x08000000>;
	};
};
