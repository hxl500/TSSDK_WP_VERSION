## kernel/Documentation/devicetree/bindings/i2c/i2c-ts.txt
```
TS USI I2C controller

Required properties:
 - compatible: must be "ts,ts-usi-i2c"
 - reg: physical address and length of the device registers
 - interrupts: a single interrupt specifier
 - clocks: clock for the device
 - #address-cells: should be <1>
 - #size-cells: should be <0>
 - clock-frequency: the desired I2C bus clock frequency.

Examples:

	i2c@112000 {
		compatible = "ts,ts-usi-i2c";
		interrupt-parent = <&gic>;
		interrupts = <0 29 4>;
		reg = <0x0 0xf0d89000 0x0 0x1000>;
		clock-frequency = <100000>;
		clock-names = "usi_clk";
		#address-cells = <1>;
		#size-cells = <0>;
	};
```

## kernel/Documentation/devicetree/bindings/media/ts/ts,sys.txt
```
Tsingmicro media system module
-------------------------------

General concept
---------------
Media system module is responsible for:
creating sysfs config file
allocating buffer for user


Required properties:

- compatible: Must be "ts,sys".


Example:

	sys: sys {
		compatible = "ts,sys";
		status = "disabled";
	};
```

## kernel/Documentation/devicetree/bindings/misc/ts,vpu-h265.txt
```
TsingMicro VPU H265 codec for tx5215, tx5112, dt53
-----------------------------------------------------
Required properties:
- compatible : "ts,h265"
- DEPRECATED: compatible : "ts,h265"
- reg : Location and size of register space

Optional properties:
- memory-region: If present, the itf buffer is allocated by driver.

Example:
	vpu_h265: vpu_h265@F24ED000 {
                       compatible = "ts,h265";
                       memory-region = <&h265_reserved>;
                       reg = <0xF24ED000 0x1000>;
                       interrupt-parent = <&gic>;
                       interrupts = <0 50 IRQ_TYPE_LEVEL_HIGH>;
                       status = "disabled";
               };
```

## kernel/Documentation/devicetree/bindings/pinctrl/ts,ts-pinctrl.txt
```
* Binding for ts pinctrl

Required properties:
  - compatible: "ts,ts-pinctrl";
  - reg: offset and length of ts padctrl;
  - ts,npins: number of ts pin;

Optional properties:
  -init-function: A string of function name, the driver will configure all the
   groups under the specified function once after initialization, but these pins
   will not be occupied.

The ts pin configuration node is a node of a group of pins which can be
used for a specific function. This node represents both mux and config of the
pins in that group. Each configuration node can consist of multiple nodes
describing the pinmux and pinconf options. Those nodes can be pinmux nodes or
pinconf nodes.

Required subnode describing the function. The name of each subnode will be used
as function name.

Required properties for configuration nodes:
  - groups: A list of pinmux groups, need to be the same as the node name.
  - function: The name of a pinmux function to activate for the specified set
    of groups, need to be the same as the function node name.
  - ts,pins: integers array, represents a group of pins mux and config setting.
  - mux,val: 0 to 3 mean the specific device function.

Please refer to pinctrl-bindings.txt in this directory for details of the
common pinctrl bindings used by client devices, including the meaning of the
phrase "pin configuration node".

The following generic properties as defined in pinctrl-bindings.txt are valid
to specify in a pinconf subnode:
    bias-pull-up		- pull up the pin
    bias-pull-down		- pull down the pin
    drive-strength		- sink or source at most X mA
    input-schmitt-enable	- enable schmitt-trigger mode
    input-schmitt-disable	- disable schmitt-trigger mode

Example:
	pinctrl: pinctrl@f0d95000 {
		compatible = "ts,ts-pinctrl";
		reg = <0x0 0xf0d95000 0x0 0x1000>;
		ts,npins = <97>;
		spi2 {
			spi2_pinctrl: spi2_grp {
				ts,pins = <17 18 19 20>;
				mux,val = <1>;
				function = "spi2";
				groups = "spi2_grp";
			};
		};
		PA {
			PA0_pinctrl: PA0_grp {
				ts,pins = <0>;
				mux,val = <3>;
				function = "PA";
				groups = "PA0_grp";
			};
			PA1_pinctrl: PA1_grp {
				ts,pins = <1>;
				mux,val = <3>;
				function = "PA";
				groups = "PA1_grp";
			};
		};
	};

Examples of use:
	node {
		pinctrl-names = "default","default";
		pinctrl-0 = <&PA0_pinctrl>;
		pinctrl-1 = <&PA1_pinctrl>;
	};
```

## kernel/arch/arm/configs/ts_tx52xx_ipc_defconfig
```kconfig
# CONFIG_LOCALVERSION_AUTO is not set
CONFIG_KERNEL_LZO=y
CONFIG_SYSVIPC=y
CONFIG_IRQ_DOMAIN_DEBUG=y
CONFIG_HIGH_RES_TIMERS=y
CONFIG_LOG_BUF_SHIFT=14
CONFIG_CC_OPTIMIZE_FOR_SIZE=y
CONFIG_EMBEDDED=y
CONFIG_SLAB=y
# CONFIG_STRICT_KERNEL_RWX is not set
CONFIG_MODULES=y
CONFIG_MODULE_UNLOAD=y
CONFIG_ARCH_TS=y
CONFIG_ARCH_TS_TX5215=y
CONFIG_SMP=y
CONFIG_PREEMPT=y
# CONFIG_COMPACTION is not set
CONFIG_CMA=y
CONFIG_CMA_DEBUG=y
CONFIG_CMA_DEBUGFS=y
CONFIG_CMA_AREAS=3
CONFIG_DEPRECATED_PARAM_STRUCT=y
CONFIG_ZBOOT_ROM_TEXT=0x0
CONFIG_ZBOOT_ROM_BSS=0x0
CONFIG_ARM_APPENDED_DTB=y
CONFIG_ARM_ATAG_DTB_COMPAT=y
CONFIG_CPU_FREQ=y
CONFIG_CPUFREQ_DT=y
CONFIG_CPU_IDLE=y
CONFIG_VFP=y
CONFIG_NEON=y
CONFIG_NET=y
CONFIG_PACKET=y
CONFIG_UNIX=y
CONFIG_INET=y
CONFIG_IP_MULTICAST=y
CONFIG_IP_ADVANCED_ROUTER=y
CONFIG_IP_PNP=y
CONFIG_IP_PNP_DHCP=y
CONFIG_INET_UDP_DIAG=y
CONFIG_NETFILTER=y
CONFIG_IP_NF_IPTABLES=y
CONFIG_IP_NF_FILTER=y
CONFIG_CFG80211=m
CONFIG_DEVTMPFS=y
CONFIG_DEVTMPFS_MOUNT=y
CONFIG_DMA_CMA=y
CONFIG_CMA_SIZE_MBYTES=0
CONFIG_MTD=y
CONFIG_MTD_CMDLINE_PARTS=y
CONFIG_MTD_BLOCK=y
CONFIG_MTD_M25P80=y
CONFIG_MTD_SPI_NOR=y
CONFIG_SPI_CADENCE_QUADSPI_NOR=y
CONFIG_BLK_DEV_LOOP=y

CONFIG_EEPROM_AT24=m
CONFIG_SCSI=y
CONFIG_BLK_DEV_SD=y
CONFIG_NETDEVICES=y
# CONFIG_NET_VENDOR_ALACRITECH is not set
# CONFIG_NET_VENDOR_AMAZON is not set
# CONFIG_NET_VENDOR_AQUANTIA is not set
# CONFIG_NET_VENDOR_ARC is not set
# CONFIG_NET_CADENCE is not set
# CONFIG_NET_VENDOR_BROADCOM is not set
# CONFIG_NET_VENDOR_CIRRUS is not set
# CONFIG_NET_VENDOR_EZCHIP is not set
# CONFIG_NET_VENDOR_FARADAY is not set
# CONFIG_NET_VENDOR_HISILICON is not set
# CONFIG_NET_VENDOR_HUAWEI is not set
# CONFIG_NET_VENDOR_INTEL is not set
# CONFIG_NET_VENDOR_MARVELL is not set
# CONFIG_NET_VENDOR_MELLANOX is not set
# CONFIG_NET_VENDOR_MICREL is not set
# CONFIG_NET_VENDOR_MICROCHIP is not set
# CONFIG_NET_VENDOR_NATSEMI is not set
# CONFIG_NET_VENDOR_NETRONOME is not set
# CONFIG_NET_VENDOR_QUALCOMM is not set
# CONFIG_NET_VENDOR_RENESAS is not set
# CONFIG_NET_VENDOR_ROCKER is not set
# CONFIG_NET_VENDOR_SAMSUNG is not set
# CONFIG_NET_VENDOR_SEEQ is not set
# CONFIG_NET_VENDOR_SOLARFLARE is not set
# CONFIG_NET_VENDOR_SMSC is not set
CONFIG_STMMAC_ETH=y
CONFIG_DWMAC_DWC_QOS_ETH=y
# CONFIG_NET_VENDOR_VIA is not set
# CONFIG_NET_VENDOR_WIZNET is not set
# CONFIG_NET_VENDOR_SYNOPSYS is not set
CONFIG_MOTORCOMM_PHY_NOXTAL=y
# CONFIG_WLAN_VENDOR_ADMTEK is not set
# CONFIG_WLAN_VENDOR_ATH is not set
# CONFIG_WLAN_VENDOR_ATMEL is not set
# CONFIG_WLAN_VENDOR_BROADCOM is not set
# CONFIG_WLAN_VENDOR_CISCO is not set
# CONFIG_WLAN_VENDOR_INTEL is not set
# CONFIG_WLAN_VENDOR_INTERSIL is not set
# CONFIG_WLAN_VENDOR_MARVELL is not set
# CONFIG_WLAN_VENDOR_MEDIATEK is not set
# CONFIG_WLAN_VENDOR_RALINK is not set
# CONFIG_WLAN_VENDOR_RSI is not set
# CONFIG_WLAN_VENDOR_ST is not set
# CONFIG_WLAN_VENDOR_TI is not set
# CONFIG_WLAN_VENDOR_ZYDAS is not set
# CONFIG_WLAN_VENDOR_QUANTENNA is not set
CONFIG_INPUT_EVDEV=y
CONFIG_KEYBOARD_GPIO=y
CONFIG_KEYBOARD_GPIO_POLLED=y
# CONFIG_VT is not set
CONFIG_SERIAL_8250=y
CONFIG_SERIAL_8250_CONSOLE=y
CONFIG_SERIAL_8250_DW=y
CONFIG_HW_RANDOM=y
CONFIG_I2C_CHARDEV=y
CONFIG_I2C_DESIGNWARE_PLATFORM=y
CONFIG_I2C_TS=y
CONFIG_SPI=y
CONFIG_SPI_TS=m
CONFIG_SPI_DESIGNWARE=m
CONFIG_SPI_DW_MMIO=m
CONFIG_GPIOLIB=y
CONFIG_GPIO_SYSFS=y
CONFIG_GPIO_DWAPB=y
CONFIG_POWER_RESET=y
CONFIG_POWER_RESET_GPIO=y
CONFIG_POWER_SUPPLY=y
# CONFIG_HWMON is not set
CONFIG_THERMAL=y
CONFIG_WATCHDOG=y
CONFIG_DW_WATCHDOG=m
CONFIG_REGULATOR=y
CONFIG_REGULATOR_FIXED_VOLTAGE=y
CONFIG_MEDIA_SUPPORT=y
CONFIG_MEDIA_CAMERA_SUPPORT=y
CONFIG_MEDIA_CONTROLLER=y
CONFIG_VIDEO_V4L2_SUBDEV_API=y
CONFIG_VIDEO_ADV_DEBUG=y
CONFIG_V4L_PLATFORM_DRIVERS=y
CONFIG_DRM=y
CONFIG_DRM_TS=y
CONFIG_DRM_TS_VIRT_HDMI=y
CONFIG_DRM_TS_DW_MIPI_DSI=y
CONFIG_SOUND=y
CONFIG_SND=y
CONFIG_SND_SOC=y
CONFIG_SND_SOC_GENERIC_DMAENGINE_PCM=y
CONFIG_USB=y
CONFIG_USB_EHCI_HCD=y
CONFIG_USB_STORAGE=y
CONFIG_USB_DWC2=y
CONFIG_MMC=y
CONFIG_MMC_TEST=y
CONFIG_MMC_DEBUG=y
CONFIG_MMC_DW=y
CONFIG_RTC_CLASS=y
CONFIG_RTC_DRV_TS=m
CONFIG_DMADEVICES=y
CONFIG_DW_AXI_DMAC=y
CONFIG_DW_AHB_DMAC=y
CONFIG_STAGING=y
CONFIG_ION=y
CONFIG_ION_SYSTEM_HEAP=y
CONFIG_ION_CMA_HEAP=y
# CONFIG_IOMMU_SUPPORT is not set
CONFIG_TS_DMA_TRACE=y
CONFIG_MEMORY=y
CONFIG_IIO=y
CONFIG_TS_GPADC=y
CONFIG_PWM=y
CONFIG_PWM_TS=m
CONFIG_ANDROID=y
CONFIG_MSDOS_FS=y
CONFIG_VFAT_FS=y
CONFIG_TMPFS=y
CONFIG_JFFS2_FS=y
CONFIG_JFFS2_COMPRESSION_OPTIONS=y
CONFIG_JFFS2_LZO=y
CONFIG_JFFS2_CMODE_FAVOURLZO=y
CONFIG_SQUASHFS=y
CONFIG_SQUASHFS_FILE_DIRECT=y
CONFIG_SQUASHFS_DECOMP_MULTI_PERCPU=y
# CONFIG_SQUASHFS_ZLIB is not set
CONFIG_SQUASHFS_LZO=y
CONFIG_SQUASHFS_XZ=y
CONFIG_SQUASHFS_4K_DEVBLK_SIZE=y
CONFIG_SQUASHFS_EMBEDDED=y
CONFIG_NFS_FS=y
CONFIG_NLS_CODEPAGE_437=y
CONFIG_NLS_CODEPAGE_936=y
CONFIG_NLS_ISO8859_1=y
CONFIG_PRINTK_TIME=y
CONFIG_DYNAMIC_DEBUG=y
CONFIG_DEBUG_INFO=y
CONFIG_DEBUG_FS=y
# CONFIG_SCHED_DEBUG is not set
CONFIG_STACKTRACE=y
# CONFIG_DEBUG_BUGVERBOSE is not set
CONFIG_RCU_TRACE=y
# CONFIG_TRACING_EVENTS_GPIO is not set
CONFIG_DEBUG_USER=y
CONFIG_CRYPTO_CRC32C=y
CONFIG_CRYPTO_DRBG_MENU=y
CONFIG_CRC16=y
CONFIG_CRC_ITU_T=m
CONFIG_XZ_DEC=y
CONFIG_NET_INGRESS=y
CONFIG_NETFILTER=y
CONFIG_NETFILTER_ADVANCED=y
CONFIG_NETFILTER_INGRESS=y
CONFIG_NETFILTER_XTABLES=y
CONFIG_IP_NF_IPTABLES=y
CONFIG_IP_NF_FILTER=y

CONFIG_NVMEM=y
CONFIG_NVMEM_TS_OCOTP=y
```
