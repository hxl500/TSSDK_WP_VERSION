## uboot/arch/arm/mach-ts/Kconfig
```kconfig
if ARCH_TS

config SPL_FS_FAT
	default y

config SPL_LIBCOMMON_SUPPORT
	default y

config SPL_LIBDISK_SUPPORT
	default y

config SPL_LIBGENERIC_SUPPORT
	default y

config SPL_MMC_SUPPORT
	default y if MMC_SDHCI_ZYNQ

config SPL_SERIAL_SUPPORT
	default y

config SPL_SPI_FLASH_SUPPORT
	default y if ZYNQ_QSPI

config SPL_SPI_SUPPORT
	default y if ZYNQ_QSPI

config SYS_BOARD
	default "tx536" if ARCH_TS_TX536
	default "tx5215"  if ARCH_TS_TX5215
	default "tx5112"  if ARCH_TS_TX5112
    default "tx5336"  if ARCH_TS_TX5336
    
config SYS_VENDOR
	string "Vendor name"
	default "tsingmicro"

config SYS_SOC
	default "ts"

config SYS_CONFIG_NAME
	string "Board configuration name"
	default "ts_tx536" if ARCH_TS_TX536
	default "ts_tx5215"  if ARCH_TS_TX5215
	default "ts_tx5112"  if ARCH_TS_TX5112	
	help
	  This option contains information about board configuration name.
	  Based on this option include/configs/<CONFIG_SYS_CONFIG_NAME>.h header
	  will be used for board configuration.

config SYS_MEM_RSVD_FOR_MMU
	bool "Reserve memory for MMU Table"
	help
	  If defined this option is used to setup different space for
	  MMU table than the one which will be allocated during
	  relocation.

config BOOT_INIT_FILE
	string "boot.bin init register filename"
	depends on SPL
	default ""
	help
	  Add register writes to boot.bin format (max 256 pairs).
	  Expect a table of register-value pairs, e.g. "0x12345678 0x4321"

config PMUFW_INIT_FILE
	string "PMU firmware"
	depends on SPL
	default ""
	help
	  Include external PMUFW (Platform Management Unit FirmWare) to
	  a Xilinx bootable image (boot.bin).

config ZYNQMP_SPL_PM_CFG_OBJ_FILE
	string "PMU firmware configuration object to load at runtime by SPL"
	depends on SPL
	help
	  Path to a binary PMU firmware configuration object to be linked
	  into U-Boot SPL and loaded at runtime into the PMU firmware.

	  The ZynqMP Power Management Unit (PMU) needs a configuration
	  object for most SoC peripherals to work. To have it loaded by
	  U-Boot SPL set here the file name (absolute path or relative to
	  the top source tree) of your configuration, which must be a
	  binary blob. It will be linked in the SPL binary and loaded
	  into the PMU firmware by U-Boot SPL during board
	  initialization.

	  Leave this option empty if your PMU firmware has a hard-coded
	  configuration object or you are loading it by any other means.

config ZYNQMP_USB
	bool "Configure ZynqMP USB"

config ZYNQMP_NO_DDR
	bool "Disable DDR MMU mapping"
	help
	  This option configures MMU with no DDR to avoid speculative
	  access to DDR memory where DDR is not present.

config SYS_MALLOC_F_LEN
	default 0x800

config DEFINE_TCM_OCM_MMAP
	bool "Define TCM and OCM memory in MMU Table"
	default y if MP
	help
	  This option if enabled defines the TCM and OCM memory and its
	  memory attributes in MMU table entry.

config ZYNQMP_PSU_INIT_ENABLED
	bool "Include psu_init"
	help
	  Include psu_init to full u-boot. SPL include psu_init by default.

config SPL_ZYNQMP_ALT_BOOTMODE_ENABLED
	bool "Overwrite SPL bootmode"
	depends on SPL
	help
	  Overwrite bootmode selected via boot mode pins to tell SPL what should
	  be the next boot device.

config ZYNQ_SDHCI_MAX_FREQ
	default 200000000

config UBOOT_ENABLE_SMP
    bool "Enable SMP Of The Auxiliary Register"
    default y if ARCH_TS_TX5112
    default y if ARCH_TS_TX5215
    select ARM_ERRATA_454179
    help
      Enable the ACTLR.MSP bit. The caches are disabled when ACTLR.SMP is set to 0 regardless of the value of the cache enable bit

endif
```

## uboot/board/tsingmicro/Kconfig
```kconfig
# tsingmicro-License-Identifier: GPL-2.0
#
# Copyright (c) 2018, captain Tsingmicro <captain@tsingmicro.com>

config BOOT_SCRIPT_OFFSET
	hex "Boot script offset"
	depends on ARCH_TS
	default 0x3E80000 if ARCH_TS
	help
	   Specifies distro boot script offset in NAND/NOR flash.

config ON_FPGA
	bool "is run on fpga"
	default n
	depends on ARCH_TS

source "board/tsingmicro/tx5112/Kconfig"
```

## uboot/board/tsingmicro/tx5112/Kconfig
```kconfig
# Copyright (c) 2023, Tsingmicro, Inc.
#
# SPDX-License-Identifier: GPL-2.0

if ARCH_TS_TX5112

config GMAC_PHY_SPI_CLK_INIT
	bool "Enable Spi Clk To Phy"
	default n
	help
	   when use tx51xx chip, use mac_txclk provide clk for phy, when in 10m/s
	   speed, need spi clk provide 25mhz instead of mac_txclk.

endif
```

## uboot/cmd/dma/Kconfig
```kconfig
menu "TS specific command line interface"

config CMD_DMA
	bool "command for verifying DDR features"
	default n
	help
	   Support for testing ddr4 on TS platforms. This command
	   supports memory verification, memory comapre if supported.

endmenu
```

## uboot/configs/ts_tx5215dv200_evb88_defconfig
```kconfig
CONFIG_ARM=y
CONFIG_SYS_CONFIG_NAME="ts_tx5215dv200_evb88"
CONFIG_ARCH_TS_TX5215=y
CONFIG_SYS_TEXT_BASE=0x1000000
CONFIG_NR_DRAM_BANKS=1
CONFIG_ENV_SIZE=0x3000
CONFIG_ENV_OFFSET=0xc000
CONFIG_ENV_SECT_SIZE=0x1000
CONFIG_DM_GPIO=y
CONFIG_PRE_CON_BUF_ADDR=0x1100000
# CONFIG_ON_FPGA is not set
CONFIG_DEFAULT_DEVICE_TREE="ts-tx5215dv200-evb88"
CONFIG_FIT=y
# CONFIG_FIT_ENABLE_SHA256_SUPPORT is not set
CONFIG_BOOTDELAY=0
CONFIG_PRE_CONSOLE_BUFFER=y
CONFIG_SUPPORT_RAW_INITRD=y
# CONFIG_BOARD_LATE_INIT is not set
# CONFIG_DISPLAY_CPUINFO is not set
CONFIG_BOARD_EARLY_INIT_F=y
CONFIG_BOARD_EARLY_INIT_R=y
CONFIG_HUSH_PARSER=y
CONFIG_AUTOBOOT_KEYED=y
CONFIG_AUTOBOOT_DELAY_STR="b"
CONFIG_AUTOBOOT_STOP_STR="t"
CONFIG_AUTOBOOT_KEYED_CTRLC=y
# CONFIG_CMD_BDI is not set
# CONFIG_CMD_CONSOLE is not set
CONFIG_CMD_BOOTZ=y
# CONFIG_BOOTM_NETBSD is not set
# CONFIG_BOOTM_PLAN9 is not set
# CONFIG_BOOTM_RTEMS is not set
# CONFIG_BOOTM_VXWORKS is not set
# CONFIG_CMD_ELF is not set
# CONFIG_CMD_IMI is not set
# CONFIG_CMD_XIMG is not set
# CONFIG_CMD_EXPORTENV is not set
# CONFIG_CMD_IMPORTENV is not set
CONFIG_CMD_ERASEENV=y
# CONFIG_CMD_ENV_EXISTS is not set
CONFIG_CMD_NVEDIT_INFO=y
CONFIG_CMD_NVEDIT_LOAD=y
CONFIG_CMD_NVEDIT_SELECT=y
# CONFIG_CMD_CRC32 is not set
# CONFIG_CMD_RANDOM is not set
CONFIG_CMD_CLK=y
# CONFIG_CMD_LOADS is not set
CONFIG_CMD_MTD=y
# CONFIG_CMD_PINMUX is not set
# CONFIG_CMD_ITEST is not set
# CONFIG_CMD_SOURCE is not set
# CONFIG_CMD_SETEXPR is not set
# CONFIG_CMD_BOOTP is not set
# CONFIG_CMD_NFS is not set
CONFIG_CMD_PING=y
# CONFIG_MP is not set
CONFIG_CMD_FAT=y
CONFIG_CMD_FS_GENERIC=y
CONFIG_CMD_MTDPARTS=y
CONFIG_CMD_MTDPARTS_SPREAD=y
CONFIG_CMD_MTDPARTS_SHOW_NET_SIZES=y
CONFIG_CMD_INI=y
CONFIG_OF_EMBED=y
CONFIG_ENV_IS_NOWHERE=y
CONFIG_ENV_IS_IN_SPI_FLASH=y
CONFIG_ENV_ADDR=0xc000
CONFIG_SYS_RELOC_GD_ENV_ADDR=y
CONFIG_NET_RANDOM_ETHADDR=y
CONFIG_TFTP_BLOCKSIZE=1462
# CONFIG_DM_WARN is not set
# CONFIG_DM_DEVICE_REMOVE is not set
CONFIG_CLK_CCF=y
CONFIG_CLK_COMPOSITE_CCF=y
CONFIG_DWAPB_GPIO=y
# CONFIG_INPUT is not set
CONFIG_MTD=y
CONFIG_DM_MTD=y
CONFIG_MTD_SPI_NAND=y
CONFIG_SF_DEFAULT_SPEED=20000000
CONFIG_SPI_FLASH_SFDP_SUPPORT=y
CONFIG_SPI_FLASH_GIGADEVICE=y
CONFIG_SPI_FLASH_ISSI=y
CONFIG_SPI_FLASH_SPANSION=y
CONFIG_SPI_FLASH_WINBOND=y
CONFIG_SPI_FLASH_MTD=y
CONFIG_PHY_MOTORCOMM=y
CONFIG_DM_ETH_PHY=y
CONFIG_DWC_ETH_QOS=y
CONFIG_PINCTRL=y
CONFIG_DM_RESET=y
CONFIG_SYS_NS16550=y
CONFIG_SPI=y
CONFIG_CADENCE_QSPI=y
CONFIG_FS_CRAMFS=y
# CONFIG_REGEX is not set
CONFIG_SHA256=y
# CONFIG_EFI_LOADER is not set

CONFIG_MISC=y
CONFIG_CMD_FUSE=y

# CONFIG_TS_CRYPTO=y
# CONFIG_TS_SKE=y
# CONFIG_TS_HASH=y
# CONFIG_TS_PKE=y
```

## uboot/configs/ts_tx5215dv300_ansjer_defconfig
```kconfig
CONFIG_ARM=y
CONFIG_SYS_CONFIG_NAME="ts_tx5215dv300_ansjer"
CONFIG_ARCH_TS_TX5215=y
CONFIG_SYS_TEXT_BASE=0x1000000
CONFIG_NR_DRAM_BANKS=1
CONFIG_ENV_SIZE=0x10000
CONFIG_ENV_OFFSET=0x1c0000
CONFIG_ENV_SECT_SIZE=0x1000
CONFIG_DM_GPIO=y
CONFIG_PRE_CON_BUF_ADDR=0x1100000
CONFIG_DEFAULT_DEVICE_TREE="ts_tx5215dv300_ansjer"
CONFIG_FIT=y
# CONFIG_FIT_ENABLE_SHA256_SUPPORT is not set
CONFIG_NAND_BOOT=y
CONFIG_BOOTDELAY=0
CONFIG_PRE_CONSOLE_BUFFER=y
CONFIG_SUPPORT_RAW_INITRD=y
# CONFIG_BOARD_LATE_INIT is not set
# CONFIG_DISPLAY_CPUINFO is not set
CONFIG_BOARD_EARLY_INIT_F=y
CONFIG_BOARD_EARLY_INIT_R=y
CONFIG_HUSH_PARSER=y
CONFIG_AUTOBOOT_KEYED=y
CONFIG_AUTOBOOT_DELAY_STR="b"
CONFIG_AUTOBOOT_STOP_STR="t"
CONFIG_AUTOBOOT_KEYED_CTRLC=y
# CONFIG_CMD_BDI is not set
# CONFIG_CMD_CONSOLE is not set
CONFIG_CMD_BOOTZ=y
# CONFIG_BOOTM_NETBSD is not set
# CONFIG_BOOTM_PLAN9 is not set
# CONFIG_BOOTM_RTEMS is not set
# CONFIG_BOOTM_VXWORKS is not set
# CONFIG_CMD_ELF is not set
# CONFIG_CMD_IMI is not set
# CONFIG_CMD_XIMG is not set
# CONFIG_CMD_EXPORTENV is not set
# CONFIG_CMD_IMPORTENV is not set
CONFIG_CMD_ERASEENV=y
# CONFIG_CMD_ENV_EXISTS is not set
CONFIG_CMD_NVEDIT_INFO=y
CONFIG_CMD_NVEDIT_LOAD=y
CONFIG_CMD_NVEDIT_SELECT=y
# CONFIG_CMD_CRC32 is not set
# CONFIG_CMD_RANDOM is not set
CONFIG_CMD_MEMTEST=y
CONFIG_SYS_MEMTEST_END=0x100000
CONFIG_CMD_CLK=y
# CONFIG_CMD_LOADS is not set
CONFIG_CMD_MMC=y
CONFIG_CMD_MTD=y
CONFIG_CMD_NAND_TRIMFFS=y
CONFIG_CMD_NAND_LOCK_UNLOCK=y
CONFIG_CMD_NAND_TORTURE=y
# CONFIG_CMD_PINMUX is not set
# CONFIG_CMD_ITEST is not set
# CONFIG_CMD_SOURCE is not set
# CONFIG_CMD_SETEXPR is not set
# CONFIG_CMD_BOOTP is not set
# CONFIG_CMD_NFS is not set
CONFIG_CMD_PING=y
# CONFIG_MP is not set
CONFIG_CMD_FAT=y
CONFIG_CMD_FS_GENERIC=y
CONFIG_CMD_MTDPARTS=y
CONFIG_CMD_MTDPARTS_SPREAD=y
CONFIG_CMD_MTDPARTS_SHOW_NET_SIZES=y
CONFIG_MTDPARTS_DEFAULT="f1000000.spi.0:512K(boot),4096K(kernel),2560K(romfs)ro,3584K(user),2432K(app),2432K(backup),760K(root),-(config)"
CONFIG_CMD_INI=y
CONFIG_CMD_BOOT_SELECT=y
CONFIG_OF_EMBED=y
CONFIG_ENV_IS_NOWHERE=y
CONFIG_ENV_IS_IN_NAND=y
CONFIG_ENV_IS_IN_SPI_FLASH=y
CONFIG_ENV_ADDR=0xc000
CONFIG_SYS_RELOC_GD_ENV_ADDR=y
CONFIG_NET_RANDOM_ETHADDR=y
CONFIG_TFTP_BLOCKSIZE=1462
# CONFIG_DM_WARN is not set
# CONFIG_DM_DEVICE_REMOVE is not set
CONFIG_CLK_CCF=y
CONFIG_CLK_COMPOSITE_CCF=y
CONFIG_DWAPB_GPIO=y
# CONFIG_INPUT is not set
CONFIG_SUPPORT_EMMC_BOOT=y
CONFIG_MMC_DW=y
CONFIG_MMC_DW_SNPS=y
CONFIG_MMC_SDHCI=y
CONFIG_MMC_SDHCI_SNPS=y
CONFIG_MTD=y
CONFIG_DM_MTD=y
CONFIG_NAND_DENALI_DT=y
CONFIG_MTD_SPI_NAND=y
CONFIG_SF_DEFAULT_SPEED=20000000
CONFIG_SPI_FLASH_SFDP_SUPPORT=y
CONFIG_SPI_FLASH_GIGADEVICE=y
CONFIG_SPI_FLASH_ISSI=y
CONFIG_SPI_FLASH_SPANSION=y
CONFIG_SPI_FLASH_WINBOND=y
CONFIG_SPI_FLASH_MTD=y
CONFIG_PINCTRL=y
CONFIG_DM_RESET=y
CONFIG_SYS_NS16550=y
CONFIG_SPI=y
CONFIG_CADENCE_QSPI=y
CONFIG_FS_CRAMFS=y
# CONFIG_REGEX is not set
CONFIG_SHA256=y
# CONFIG_EFI_LOADER is not set
```

## uboot/configs/ts_tx5215dv300_evb132_emmc_v1p1_defconfig
```kconfig
CONFIG_ARM=y
CONFIG_SYS_CONFIG_NAME="ts_tx5215dv300_evb132_emmc_v1p1"
CONFIG_ARCH_TS_TX5215=y
CONFIG_SYS_TEXT_BASE=0x1000000
CONFIG_NR_DRAM_BANKS=1
CONFIG_ENV_SIZE=0x3000
CONFIG_ENV_OFFSET=0xc000
CONFIG_ENV_SECT_SIZE=0x1000
CONFIG_DM_GPIO=y
CONFIG_PRE_CON_BUF_ADDR=0x1100000
CONFIG_DEFAULT_DEVICE_TREE="ts-tx5215dv300-evb132-emmc"
CONFIG_FIT=y
# CONFIG_FIT_ENABLE_SHA256_SUPPORT is not set
CONFIG_BOOTDELAY=0
CONFIG_PRE_CONSOLE_BUFFER=y
CONFIG_SUPPORT_RAW_INITRD=y
# CONFIG_BOARD_LATE_INIT is not set
# CONFIG_DISPLAY_CPUINFO is not set
CONFIG_BOARD_EARLY_INIT_F=y
CONFIG_BOARD_EARLY_INIT_R=y
CONFIG_HUSH_PARSER=y
CONFIG_AUTOBOOT_KEYED=y
CONFIG_AUTOBOOT_DELAY_STR="b"
CONFIG_AUTOBOOT_STOP_STR="t"
CONFIG_AUTOBOOT_KEYED_CTRLC=y
# CONFIG_CMD_BDI is not set
# CONFIG_CMD_CONSOLE is not set
CONFIG_CMD_BOOTZ=y
# CONFIG_BOOTM_NETBSD is not set
# CONFIG_BOOTM_PLAN9 is not set
# CONFIG_BOOTM_RTEMS is not set
# CONFIG_BOOTM_VXWORKS is not set
# CONFIG_CMD_ELF is not set
# CONFIG_CMD_IMI is not set
# CONFIG_CMD_XIMG is not set
# CONFIG_CMD_EXPORTENV is not set
# CONFIG_CMD_IMPORTENV is not set
CONFIG_CMD_ERASEENV=y
# CONFIG_CMD_ENV_EXISTS is not set
CONFIG_CMD_NVEDIT_INFO=y
CONFIG_CMD_NVEDIT_LOAD=y
CONFIG_CMD_NVEDIT_SELECT=y
# CONFIG_CMD_CRC32 is not set
# CONFIG_CMD_RANDOM is not set
CONFIG_CMD_UNZIP=y
CONFIG_CMD_CLK=y
# CONFIG_CMD_LOADS is not set
CONFIG_CMD_MMC=y
CONFIG_CMD_MTD=y
# CONFIG_CMD_PINMUX is not set
# CONFIG_CMD_ITEST is not set
# CONFIG_CMD_SOURCE is not set
# CONFIG_CMD_SETEXPR is not set
# CONFIG_CMD_BOOTP is not set
# CONFIG_CMD_NFS is not set
CONFIG_CMD_PING=y
CONFIG_CMD_TIME=y
# CONFIG_MP is not set
CONFIG_CMD_FAT=y
CONFIG_CMD_FS_GENERIC=y
CONFIG_CMD_MTDPARTS=y
CONFIG_CMD_MTDPARTS_SPREAD=y
CONFIG_CMD_MTDPARTS_SHOW_NET_SIZES=y
CONFIG_CMD_INI=y
CONFIG_CMD_BOOT_SELECT=y
CONFIG_OF_EMBED=y
CONFIG_ENV_IS_NOWHERE=y
CONFIG_ENV_IS_IN_MMC=y
CONFIG_ENV_IS_IN_SPI_FLASH=y
CONFIG_ENV_ADDR=0xc000
CONFIG_SYS_RELOC_GD_ENV_ADDR=y
CONFIG_NET_RANDOM_ETHADDR=y
CONFIG_TFTP_BLOCKSIZE=1462
# CONFIG_DM_WARN is not set
# CONFIG_DM_DEVICE_REMOVE is not set
CONFIG_CLK_CCF=y
CONFIG_CLK_COMPOSITE_CCF=y
CONFIG_DWAPB_GPIO=y
# CONFIG_INPUT is not set
CONFIG_SUPPORT_EMMC_BOOT=y
CONFIG_MMC_DW=y
CONFIG_MMC_DW_SNPS=y
CONFIG_MMC_SDHCI=y
CONFIG_MMC_SDHCI_SNPS=y
CONFIG_MTD=y
CONFIG_DM_MTD=y
CONFIG_SF_DEFAULT_SPEED=20000000
CONFIG_SPI_FLASH_SFDP_SUPPORT=y
CONFIG_SPI_FLASH_GIGADEVICE=y
CONFIG_SPI_FLASH_ISSI=y
CONFIG_SPI_FLASH_SPANSION=y
CONFIG_SPI_FLASH_WINBOND=y
CONFIG_SPI_FLASH_MTD=y
CONFIG_PHY_MOTORCOMM=y
CONFIG_DM_ETH_PHY=y
CONFIG_DWC_ETH_QOS=y
CONFIG_PINCTRL=y
CONFIG_DM_RESET=y
CONFIG_SYS_NS16550=y
CONFIG_SPI=y
CONFIG_CADENCE_QSPI=y
CONFIG_FS_EXT4=y
CONFIG_EXT4_WRITE=y
CONFIG_FS_CRAMFS=y
# CONFIG_REGEX is not set
CONFIG_SHA256=y
# CONFIG_EFI_LOADER is not set
```

## uboot/drivers/pinctrl/tsingmicro/Kconfig
```kconfig
config PINCTRL_TS_TX536
	bool "Tsingmicro tx536 pinctrl driver"
	depends on ARCH_TS_TX536
	help
	  This enables pinctrl driver for ts tx536.

	  Currently, this driver actually does nothing but print debug
	  messages when pinctrl operations are invoked.

config PINCTRL_TS_TX5336
	bool "Tsingmicro dt53 pinctrl driver"
	depends on ARCH_TS_TX5336
	default n if ARCH_TS_TX5215
	default y 

	help
	  This enables pinctrl driver for ts dt53.

	  Currently, this driver actually does nothing but print debug
	  messages when pinctrl operations are invoked.


config PINCTRL_TS_TX5215
	bool "Tsingmicro tx5215 pinctrl driver"
	depends on ARCH_TS_TX5215
	default n if ARCH_TS_TX5112
	default y
	
	help
	  This enables pinctrl driver for ts tx5215.

	  Currently, this driver actually does nothing but print debug
	  messages when pinctrl operations are invoked.
	  
config PINCTRL_TS_TX5112
	bool "Tsingmicro tx5112 pinctrl driver"
	depends on ARCH_TS_TX5112
	default n if ARCH_TS_TX5215
	default y 

	help
	  This enables pinctrl driver for ts tx5112.

	  Currently, this driver actually does nothing but print debug
	  messages when pinctrl operations are invoked.
```

## uboot/fit/ts-tx5215dv200-evb88.its
```
/*
 * Simple U-Boot uImage source file containing a single kernel and FDT blob
 */

/dts-v1/;

/ {
	description = "Simple image with Linux kernel and FDT blob";
	#address-cells = <1>;

	images {
		kernel {
			description = "Tsingmicro Linux kernel";
			data = /incbin/("./zImage");
			type = "kernel";
			arch = "arm";
			os = "linux";
			compression = "none";
			load = <0x01008000>;
			entry = <0x01008000>;
/*			hash-1 {
				algo = "crc32";
			};
*/
		};
		tx5215dv200-evb88 {
			description = "Flattened Device Tree blob";
			data = /incbin/("./ts-tx5215dv200-evb88.dtb");
			type = "flat_dt";
			arch = "arm";
			compression = "none";
			load = <0x01000000>;
/*
			hash-1 {
				algo = "crc32";
			};
*/
		};
	};

	configurations {
		default = "fdt0";
		fdt0 {
			description = "Boot Linux kernel with FDT blob";
			kernel = "kernel";
			fdt = "tx5215dv200-evb88";
		};
	};
};
```
