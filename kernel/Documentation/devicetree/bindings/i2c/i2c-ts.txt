## kernel/arch/arm/configs/ts_tx52xx_ipc_time_defconfig
```kconfig
# CONFIG_LOCALVERSION_AUTO is not set
CONFIG_KERNEL_LZ4=y
# CONFIG_SWAP is not set
CONFIG_SYSVIPC=y
# CONFIG_CROSS_MEMORY_ATTACH is not set
# CONFIG_FHANDLE is not set
CONFIG_HIGH_RES_TIMERS=y
CONFIG_LOG_BUF_SHIFT=14
CONFIG_CC_OPTIMIZE_FOR_SIZE=y
# CONFIG_SYSFS_SYSCALL is not set
# CONFIG_KALLSYMS is not set
# CONFIG_AIO is not set
# CONFIG_ADVISE_SYSCALLS is not set
CONFIG_EMBEDDED=y
# CONFIG_VM_EVENT_COUNTERS is not set
# CONFIG_SLUB_DEBUG is not set
#CONFIG_SLUB_DEBUG=y
# CONFIG_SLUB_CPU_PARTIAL is not set
# CONFIG_COMPAT_BRK is not set
# CONFIG_SLAB_MERGE_DEFAULT is not set
# CONFIG_STRICT_KERNEL_RWX is not set
# CONFIG_STRICT_MODULE_RWX is not set
CONFIG_MODULES=y
CONFIG_MODULE_UNLOAD=y
# CONFIG_LBDAF is not set
# CONFIG_BLK_DEV_BSG is not set
# CONFIG_IOSCHED_CFQ is not set
# CONFIG_MQ_IOSCHED_DEADLINE is not set
# CONFIG_MQ_IOSCHED_KYBER is not set
CONFIG_ARCH_TS=y
CONFIG_ARCH_TS_TX5215=y
# CONFIG_HARDEN_BRANCH_PREDICTOR is not set
# CONFIG_ARM_ERRATA_643719 is not set
CONFIG_SMP=y
CONFIG_NR_CPUS=2
# CONFIG_CPU_SW_DOMAIN_PAN is not set
# CONFIG_COMPACTION is not set
CONFIG_CMA=y
CONFIG_CMA_AREAS=2
CONFIG_CMA_ALIGNMENT=2
CONFIG_DEPRECATED_PARAM_STRUCT=y
CONFIG_ZBOOT_ROM_TEXT=0x0
CONFIG_ZBOOT_ROM_BSS=0x0
CONFIG_ARM_APPENDED_DTB=y
CONFIG_ARM_ATAG_DTB_COMPAT=y
# CONFIG_CMDLINE="quiet root=/dev/mtdblock1 rootfstype=squashfs init=/sbin/init rootwait mtdparts=f1000000.spi.0:4608K(boot-kernel),3M(romfs)ro,7M(user),-(root) lpj=5000000"
# CONFIG_CMDLINE_EXTEND=y
CONFIG_VFP=y
CONFIG_NEON=y
# CONFIG_COREDUMP is not set
# CONFIG_SUSPEND is not set
CONFIG_NET=y
CONFIG_PACKET=y
CONFIG_UNIX=y
CONFIG_INET=y
CONFIG_IP_MULTICAST=y
# CONFIG_IPV6 is not set
CONFIG_CFG80211=m
CONFIG_CFG80211_WEXT=y
CONFIG_MAC80211=m
CONFIG_DEVTMPFS=y
CONFIG_DEVTMPFS_MOUNT=y
# CONFIG_PREVENT_FIRMWARE_BUILD is not set
# CONFIG_FW_LOADER is not set
# CONFIG_ALLOW_DEV_COREDUMP is not set
CONFIG_DMA_CMA=y
CONFIG_CMA_SIZE_MBYTES=0
CONFIG_MTD=y
CONFIG_MTD_CMDLINE_PARTS=y
# CONFIG_MTD_OF_PARTS is not set
CONFIG_MTD_BLOCK=y
CONFIG_MTD_SPI_NOR=y
CONFIG_SPI_CADENCE_QUADSPI_NOR=y
CONFIG_NETDEVICES=y
# CONFIG_NET_VENDOR_ALACRITECH is not set
# CONFIG_NET_VENDOR_AMAZON is not set
# CONFIG_NET_VENDOR_AQUANTIA is not set
# CONFIG_NET_VENDOR_ARC is not set
# CONFIG_NET_CADENCE is not set
# CONFIG_NET_VENDOR_BROADCOM is not set
# CONFIG_NET_VENDOR_CIRRUS is not set
# CONFIG_NET_VENDOR_EZCHIP is not set
# CONFIG_NET_VENDOR_FARADAY is not set
# CONFIG_NET_VENDOR_HISILICON is not set
# CONFIG_NET_VENDOR_HUAWEI is not set
# CONFIG_NET_VENDOR_INTEL is not set
# CONFIG_NET_VENDOR_MARVELL is not set
# CONFIG_NET_VENDOR_MELLANOX is not set
# CONFIG_NET_VENDOR_MICREL is not set
# CONFIG_NET_VENDOR_MICROCHIP is not set
# CONFIG_NET_VENDOR_NATSEMI is not set
# CONFIG_NET_VENDOR_NETRONOME is not set
# CONFIG_NET_VENDOR_QUALCOMM is not set
# CONFIG_NET_VENDOR_RENESAS is not set
# CONFIG_NET_VENDOR_ROCKER is not set
# CONFIG_NET_VENDOR_SAMSUNG is not set
# CONFIG_NET_VENDOR_SEEQ is not set
# CONFIG_NET_VENDOR_SOLARFLARE is not set
# CONFIG_NET_VENDOR_SMSC is not set
CONFIG_TS_H265_TX5215=y
CONFIG_STMMAC_ETH=y
CONFIG_DWMAC_DWC_QOS_ETH=y
# CONFIG_NET_VENDOR_VIA is not set
# CONFIG_NET_VENDOR_WIZNET is not set
# CONFIG_NET_VENDOR_SYNOPSYS is not set
CONFIG_MOTORCOMM_PHY_NOXTAL=y
# CONFIG_WLAN_VENDOR_ADMTEK is not set
# CONFIG_WLAN_VENDOR_ATH is not set
# CONFIG_WLAN_VENDOR_ATMEL is not set
# CONFIG_WLAN_VENDOR_BROADCOM is not set
# CONFIG_WLAN_VENDOR_CISCO is not set
# CONFIG_WLAN_VENDOR_INTEL is not set
# CONFIG_WLAN_VENDOR_INTERSIL is not set
# CONFIG_WLAN_VENDOR_MARVELL is not set
# CONFIG_WLAN_VENDOR_MEDIATEK is not set
# CONFIG_WLAN_VENDOR_RALINK is not set
# CONFIG_WLAN_VENDOR_REALTEK is not set
# CONFIG_WLAN_VENDOR_RSI is not set
# CONFIG_WLAN_VENDOR_ST is not set
# CONFIG_WLAN_VENDOR_TI is not set
# CONFIG_WLAN_VENDOR_ZYDAS is not set
# CONFIG_WLAN_VENDOR_QUANTENNA is not set
CONFIG_INPUT=m
CONFIG_INPUT_EVDEV=m
# CONFIG_KEYBOARD_ATKBD is not set
# CONFIG_INPUT_KEYBOARD is not set
CONFIG_KEYBOARD_GPIO=m
# CONFIG_INPUT_MOUSE is not set
# CONFIG_SERIO is not set
# CONFIG_VT is not set
# CONFIG_LEGACY_PTYS is not set
# CONFIG_LDISC_AUTOLOAD is not set
CONFIG_SERIAL_8250=y
# CONFIG_SERIAL_8250_DEPRECATED_OPTIONS is not set
CONFIG_SERIAL_8250_CONSOLE=y
CONFIG_SERIAL_8250_DMA=n
CONFIG_SERIAL_8250_NR_UARTS=2
CONFIG_SERIAL_8250_RUNTIME_UARTS=2
CONFIG_SERIAL_8250_DW=y
# CONFIG_HW_RANDOM is not set
CONFIG_I2C=y
# CONFIG_I2C_COMPAT is not set
CONFIG_I2C_CHARDEV=y
CONFIG_I2C_MUX=m
CONFIG_I2C_DESIGNWARE_PLATFORM=y
CONFIG_SPI=y
# CONFIG_SPI_MEM is not set
CONFIG_SPI_CADENCE_QUADSPI=m
CONFIG_SPI_TS=m
CONFIG_SPI_DESIGNWARE=m
CONFIG_SPI_DW_MMIO=m
# CONFIG_PTP_1588_CLOCK is not set
CONFIG_GPIOLIB=y
CONFIG_GPIO_SYSFS=y
CONFIG_GPIO_DWAPB=y
# CONFIG_HWMON is not set
CONFIG_WATCHDOG=y
CONFIG_DW_WATCHDOG=m
# CONFIG_RC_CORE is not set
CONFIG_MEDIA_SUPPORT=y
CONFIG_MEDIA_CAMERA_SUPPORT=y
CONFIG_MEDIA_CONTROLLER=y
CONFIG_VIDEO_V4L2_SUBDEV_API=y
CONFIG_V4L_PLATFORM_DRIVERS=y
# CONFIG_MEDIA_SUBDRV_AUTOSELECT is not set
CONFIG_SOUND=y
CONFIG_SND=y
# CONFIG_SND_SUPPORT_OLD_API is not set
# CONFIG_SND_VERBOSE_PROCFS is not set
# CONFIG_SND_ARM is not set
# CONFIG_SND_SPI is not set
CONFIG_SND_SOC=y
CONFIG_SND_SOC_GENERIC_DMAENGINE_PCM=y
# CONFIG_HID is not set
# CONFIG_USB_SUPPORT is not set
CONFIG_MMC=m
# CONFIG_PWRSEQ_EMMC is not set
# CONFIG_PWRSEQ_SIMPLE is not set
CONFIG_MMC_DW=m
CONFIG_DMADEVICES=y
CONFIG_DW_AXI_DMAC=y
CONFIG_DW_AHB_DMAC=y
CONFIG_SYNC_FILE=y
CONFIG_STAGING=y
CONFIG_ION=y
CONFIG_ION_CMA_HEAP=y
# CONFIG_IOMMU_SUPPORT is not set
CONFIG_TS_DMA_TRACE=y
CONFIG_IIO=y
CONFIG_TS_GPADC=y
CONFIG_ANDROID=y
# CONFIG_MANDATORY_FILE_LOCKING is not set
CONFIG_VFAT_FS=m
CONFIG_TMPFS=y
CONFIG_JFFS2_FS=y
CONFIG_JFFS2_COMPRESSION_OPTIONS=y
CONFIG_JFFS2_LZO=y

CONFIG_JFFS2_CMODE_FAVOURLZO=y
CONFIG_SQUASHFS=y
CONFIG_SQUASHFS_XZ=y
CONFIG_SQUASHFS_FILE_DIRECT=y
CONFIG_SQUASHFS_DECOMP_MULTI_PERCPU=y
# CONFIG_SQUASHFS_ZLIB is not set
CONFIG_SQUASHFS_LZO=y
CONFIG_SQUASHFS_4K_DEVBLK_SIZE=y
CONFIG_SQUASHFS_EMBEDDED=y
CONFIG_NFS_FS=m
CONFIG_NLS=y
CONFIG_NLS_CODEPAGE_936=m
CONFIG_NLS_CODEPAGE_437=m
CONFIG_NLS_ISO8859_1=m
# CONFIG_ENABLE_WARN_DEPRECATED is not set
# CONFIG_ENABLE_MUST_CHECK is not set
# CONFIG_SCHED_DEBUG is not set
CONFIG_STACKTRACE=y
# CONFIG_DEBUG_BUGVERBOSE is not set
# CONFIG_RCU_TRACE is not set
# CONFIG_FTRACE is not set
CONFIG_CRYPTO_ECB=m
CONFIG_CRYPTO_MICHAEL_MIC=m
CONFIG_CRYPTO_DRBG_MENU=y
# CONFIG_CRYPTO_HW is not set
CONFIG_CRC_ITU_T=m
# CONFIG_ARCH_MULTIPLATFORM is not set

CONFIG_NVMEM=y
CONFIG_NVMEM_TS_OCOTP=y
```

## kernel/arch/arm/mach-ts/Kconfig
```kconfig
config ARCH_TS
	bool "TsingMicro SoC Support"
	depends on ARCH_MULTI_V7
	select ARM_AMBA
	select ARM_GIC
	select DW_APB_TIMER_OF
if ARCH_TS

menu "TsingMicro platform type"

config ARCH_TS_TX5215
	bool "TsingMicro TX5215 family"
	depends on ARCH_TS
	select HAVE_ARM_ARCH_TIMER
	select RESET_CONTROLLER
	select PINCTRL_TS_TX5215
	select PINCTRL
	select NETPOLL
	select NET_POLL_CONTROLLER
	select MFD_SYSCON
	help
	  Support for TsingMicro V7 SoC family

config ARCH_TS_TX5112
	bool "TsingMicro TX5112 family"
	depends on ARCH_TS
	select HAVE_ARM_ARCH_TIMER
	select RESET_CONTROLLER
	select PINCTRL
	select PINCTRL_TS_TX5112
	select NETPOLL
	select NET_POLL_CONTROLLER
	select MFD_SYSCON
	help
	  Support for TsingMicro V7 SoC family

endmenu

endif
```

## kernel/drivers/dvp/Kconfig
```kconfig
config DVP_TS
	tristate "Tsingmicro dvp_drv support"
	help
		dvp driver.
	
config OS02G10
	tristate "os02g10 sensor of dvp"
	select NVMEM
	help
	   dvp need this sensor.
```

## kernel/drivers/gpu/drm/ts/Kconfig
```kconfig
config DRM_TS
	bool "DRM Support for Tsingmicro"
	select DRM_KMS_HELPER
	select DRM_KMS_CMA_HELPER
	select DRM_GEM_CMA_HELPER
	select VIDEOMODE_HELPERS
	help
	  Choose this option if you have a tsingmicro soc chipset.
	  This driver provides kernel mode setting and buffer
	  management to userspace. This driver does not provide
	  2D or 3D acceleration; acceleration is performed by other
	  IP found on the SoC.

config DRM_MALIDP
	tristate "ARM Mali Display Processor"
	depends on DRM && OF && (ARM || ARM64)
	depends on COMMON_CLK
	help
	  Choose this option if you want to compile the ARM Mali Display
	  Processor driver. It supports the DP500, DP550 and DP650 variants
	  of the hardware.
	  If compiled as a module it will be called mali-dp.

config DRM_NEMADC
	tristate "Nema DC Display Processor"
	depends on DRM && OF && (ARM || ARM64)
	depends on COMMON_CLK
	help
	  Choose this option if you want to compile the Nema DC Display
	  Processor driver.

	  If compiled as a module it will be called nemadc.

config DRM_TS_VIRT_HDMI
	tristate "VIRT HDMI"
	depends on DRM && OF && (ARM || ARM64)
	help
	  Choose this option if you want a virtul hdmi encoder.
	  This options is used when dpu connects lcd directly. In this case,
	  there is no encoder and connector, but drm need.
	  If M is selected the module will be called virt-hdmi.

config DRM_TS_DW_MIPI_DSI
	tristate "Tsingmicro DW MIPI DSI"
	select DRM_MIPI_DSI
	depends on DRM && OF && (ARM || ARM64)
	help
	  Choose this option if you want tsingmicro designware encoder and
	  connector. This options is used when dpu connects mipi lcd through
	  dsi host and phy.

config DRM_TS_DW_HDMI
	tristate "Tsingmicro DW HDMI"
	depends on DRM && OF && DRM_DW_HDMI && (ARM || ARM64)
	help
	  Choose this option if you want a dw hdmi encoder.
	  This options is used when dpu connects lcd directly. In this case,
	  there is no encoder and connector, but drm need.
	  If M is selected the module will be called dw-hdmi.

config DRM_NEMADC_SPI
	tristate "NEMADC SPI"
	depends on DRM && OF && (ARM || ARM64)
	help
	  Choose this option if you want a virtul hdmi encoder.
	  This options is used when dpu connects lcd directly. In this case,
	  there is no encoder and connector, but drm need.
	  If M is selected the module will be called virt-hdmi spi.

config DRM_NEMADC_MIPI
	tristate "NEMADC MIPI"
	depends on DRM && OF && (ARM || ARM64)
	help
	  Choose this option if you want a mipi encoder.
	  This options is used when dpu connects lcd directly. In this case,
	  there is no encoder and connector, but drm need.
	  If M is selected the module will be called mipi.
```

## kernel/drivers/net/can/ts_can/Kconfig
```kconfig
config CAN_TSCAN
	depends on HAS_IOMEM
	tristate "Bosch TS_CAN devices"
	---help---
	  Say Y here if you want to support for Bosch TS_CAN controller.
```

## kernel/drivers/pinctrl/ts/Kconfig
```kconfig
if ARCH_TS || COMPILE_TEST

config PINCTRL_TS
	bool
	depends on ARCH_TS
	select PINMUX
	select GENERIC_PINCONF

config PINCTRL_TS_TX536
	bool "TsingMicro TX536 pin control"
	depends on ARCH_TS_TX536
	select PINCTRL_TS

config PINCTRL_TS_TX5215
	bool "TsingMicro TX5215 pin control"
	depends on ARCH_TS_TX5215
	select PINCTRL_TS

config PINCTRL_TS_TX5112
	bool "TsingMicro TX5112 pin control"
	depends on ARCH_TS_TX5112
	select PINCTRL_TS

config PINCTRL_TS_TX5336
	bool "TsingMicro TX5336 pin control"
	depends on ARCH_TS_TX5336
	select PINCTRL_TS

endif
```

## kernel/drivers/sharemsg/Kconfig
```kconfig
#
# SHAREMSG support
#

config SHAREMSG
	   tristate "Tsingmicro SHAREMSG support"
	   default n
	   help

	   The is Tsingmicro SHAREMSG module.
```

## kernel/drivers/soc/ts/Kconfig
```kconfig
if ARCH_TS || COMPILE_TEST

#
# Tsingmicro Soc drivers
#

config TS_MUX_TX536
	bool "Tsingmicro TS_TX536_MIX support"
	depends on ARCH_TS_TX536
	default y if ARCH_TS_TX536
	default n
	help
		use tsingmicro tx536 chip mixed configuration.

config TS_MUX_TX5215
	bool "Tsingmicro TS_TX5215_MIX support"
	depends on ARCH_TS_TX5215
	default y if ARCH_TS_TX5215
	default n
	help
		use tsingmicro tx5215 chip mixed configuration.

config TS_MUX_TX5112
	bool "Tsingmicro TS_TX5112_MIX support"
	depends on ARCH_TS_TX5112
	default y if ARCH_TS_TX5112
	default n
	help
		use tsingmicro tx5112 chip mixed configuration.

config TS_MUX_TX5336
	bool "Tsingmicro TS_TX5336_MIX support"
	depends on ARCH_TS_TX5336
	default y if ARCH_TS_TX5336
	default n
	help
		use tsingmicro tx5336 chip mixed configuration.

config TS_DMA_HEAP
	bool "add dma heap from newer kernel"
	default n
	help
	  add dma heap from newer kernel

config TS_DMA_TRACE
	bool "enable ts dma trace function"
        default n
	help
      enable ts dma trace function

config ON_FPGA
	bool "is run on fpga"
	default n
	depends on ARCH_TS
endif
```

## kernel/sound/soc/tsingmicro/Kconfig
```kconfig
config SND_TSINGMICRO_SOC
	tristate "SoC Audio for the Tsingmicro System-on-Chip"
	depends on HAS_IOMEM
	help
	  Say Y or M if you want to add support for codecs attached to
	  the Tsingmicro SSC interface. You will also need
	  to select the audio interfaces to support below.

if SND_TSINGMICRO_SOC

config SND_TSINGMICRO_SOC_PDMIC
	tristate "Tsingmicro ASoC driver for boards using PDMIC"
	depends on OF
	select SND_SOC_GENERIC_DMAENGINE_PCM
	select REGMAP_MMIO
	help
	  Say Y if you want to add support for Tsingmicro ASoC driver for boards using
	  PDMIC.

endif
```
